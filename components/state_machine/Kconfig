## components/state_machine/Kconfig
```kconfig
menu "State machine"

    config STATE_MACHINE
        bool "Enable State Machine support"
        default y
        help
            Enabe support for State Machine Component.

    if STATE_MACHINE

        config SM_VERSION
            string "State Machine Version"
            default "2.0.0"
            help
                Define the version of the State Machine component.

        config SM_EVENT_TYPE_DEFINED_IN_APPLICATION
            bool "EVENT_TYPE and events defined in the application"
            default n
            help
                If checked, this option disables EVENT_TYPE definition in State Machine module. Instead, the application must provide EVENT_TYPE definition.
                Example: typedef enum { evNullEvent = 0, evEVENT1, .... evEVENTn, evEVENTSNUMBER } EVENT_TYPE; This makes the module partially not dependant on
                the application.

        config SM_MAX_STATE_MACHINES
            int "Maximum state machines to be registered"
            default 8
            range 1 99
            help
                This parameter defines how many state machines may be registered to be run by SM module. In future releases, the module will accept as many state machines as they are registered.

        config SM_EVENT_LOOP_QUEUE_SIZE
            int "Size of the event loop queue"
            default 12
            range 1 99
            help
                This parameter defines the size of the event loop queue. The queue is used to store events that are not processed immediately. The size of the queue should be large enough to hold all events that may be generated in a short period of time.

        config SM_EVENT_TASK_STACK_SIZE
            int "Size of the event task stack"
            default 5120
            range 512 8192
            help
                This parameter defines the size of the stack used by the event task. The stack size should be large enough to hold all local variables and function calls that may be generated in a short period of time.

        config SM_TRACER
            bool "Enable state machine tracing functions"
            default n
            help
                If checked, this option enables tracing of state machine work. This includes incoming events and state transitions.

        config SM_TRACER_LOSTEVENT
            bool "Enable tracing of events that did not triggered any transitions in state machine."
            default n
            help
                If checked, this option enables tracing of the events that did not triggered any transition in state machine. This helps find missing (not defined) transitions.

        config SM_TRACER_VERBOSE
            bool "Enable verbose tracing"
            default n
            help
                If enabled, this option activates verbose tracing. Instead events and states codes, their names are printed in logs. This way logs become more human friendly but use more flash memory.

    endif

endmenu
```

## esp-idf/sdkconfig.defaults
```kconfig
# Default values that will be used when building project for first time.


# Compiler options
CONFIG_COMPILER_CXX_EXCEPTIONS=y

# Get the project version from Kconfig
CONFIG_APP_PROJECT_VER_FROM_CONFIG=y
CONFIG_APP_PROJECT_VER="1.0.0"

CONFIG_SM_TRACER=y
SM_TRACER_VERBOSE=y
CONFIG_SM_TRACER_LOSTEVENT=y
```

## main/Kconfig
```kconfig
menu "Smart Air Application configuration"
    config SMDEMO_ESPIDF
        bool "SM Demo Application"
        default y
        help
        This option enables the SMDEMO Application.

    config BUTTON_GPIO
        int "GPIO number for button"
        default 12
        range 0 46
        help
            This option defines the GPIO number used for the button in the application.

    config BUTTON_ACTIVE_LEVEL
        int "Button active level"
        default 0
        range 0 1
        help
            This option defines the active level of the button. Set to 0 for low active and 1 for high active.

    config LED_GPIO
        int "GPIO number for LED"
        default 13
        range 0 46
        help
            This option defines the GPIO number used for the LED in the application.

    config LED_ACTIVE_LEVEL
        int "LED active level"
        default 1
        range 0 1
        help
            This option defines the active level of the LED. Set to 0 for low active and 1 for high active.

endmenu
```

## sdkconfig.defaults
```kconfig
# Default values that will be used when building project for first time.


# Compiler options
CONFIG_COMPILER_CXX_EXCEPTIONS=y

# Get the project version from Kconfig
CONFIG_APP_PROJECT_VER_FROM_CONFIG=y
CONFIG_APP_PROJECT_VER="1.0.0"

CONFIG_SM_EVENT_TYPE_DEFINED_IN_APPLICATION=y
CONFIG_SM_MAX_STATE_MACHINES=8
CONFIG_SM_EVENT_LOOP_QUEUE_SIZE=12
CONFIG_SM_EVENT_TASK_STACK_SIZE=5120
CONFIG_SM_TRACER=y
CONFIG_SM_TRACER_VERBOSE=y
CONFIG_SM_TRACER_LOSTEVENT=y

CONFIG_BUTTON_GPIO=12
CONFIG_BUTTON_ACTIVE_LEVEL=0

CONFIG_LED_GPIO=13
CONFIG_LED_ACTIVE_LEVEL=1

CONFIG_LED_BLINK_PERIOD_CHANGER_INTERVAL=60000
```
